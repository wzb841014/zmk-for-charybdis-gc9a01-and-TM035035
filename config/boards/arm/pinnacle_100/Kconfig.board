## config/boards/arm/pinnacle_100/Kconfig.board
```kconfig
# Copyright (c) 2024 ZMK Firmware
# SPDX-License-Identifier: Apache-2.0

config BOARD_PINNACLE_100
    bool "Pinnacle 100"
    select BOARD_NRF52840
    help
      Nordic Semiconductor Pinnacle 100 development board
      featuring the nRF52840 ARM Cortex-M4F processor.

# 👇 必须添加下面这部分 👇
if BOARD_PINNACLE_100

config BOARD
    string
    default "pinnacle_100"

endif
```

## config/boards/arm/pinnacle_100/Kconfig.defconfig
```kconfig
if BOARD_PINNACLE_100
    config SOC_NRF52840
        def_bool y
    config BOARD_REV_1_0 # 如果有版本定义
        def_bool y
endif
```

## config/west.yml
```yaml
manifest:
  remotes:
    - name: zmkfirmware
      url-base: https://github.com/zmkfirmware
    - name: zephyrproject-rtos
      url-base: https://github.com/zephyrproject-rtos
  projects:
    - name: zmk
      remote: zmkfirmware
      revision: v3.0
      import: app/west.yml
    - name: gc9a01a_zephyr_driver
      url: https://github.com/wzb841014/gc9a01a_zephyr_driver
      revision: main
  self:
    path: .
```
